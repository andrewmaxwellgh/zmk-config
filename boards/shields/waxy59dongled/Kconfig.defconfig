## boards/shields/waxy59dongled/Kconfig.defconfig
```kconfig
if SHIELD_WAXY59D_DONGLE

config ZMK_KEYBOARD_NAME
	default "Waxy59Dongle"

config ZMK_SPLIT_ROLE_CENTRAL
	default y

config ZMK_SPLIT
	default y

config ZMK_SPLIT_BLE_CENTRAL_PERIPHERALS
	default 1

config BT_MAX_CONN
	default 6

config BT_MAX_PAIRED
	default 6

endif
```

## boards/shields/waxy59dongled/Kconfig.shield
```kconfig
config SHIELD_WAXY59D
    def_bool $(shields_list_contains,waxy59d)

config SHIELD_WAXY59D_DONGLE
    def_bool $(shields_list_contains,waxy59d_dongle)
```
