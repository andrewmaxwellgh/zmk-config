## boards/shields/waxy59/Kconfig.defconfig
```kconfig
if SHIELD_WAXY59

config ZMK_KEYBOARD_NAME
    default "Waxy59"

endif # SHIELD_WAXY59
```

## boards/shields/waxysplit/Kconfig.shield
```kconfig
config SHIELD_WAXYSPLIT_LEFT
    def_bool $(shields_list_contains,waxysplit_left)

config SHIELD_WAXYSPLIT_RIGHT
    def_bool $(shields_list_contains,waxysplit_right)

config SHIELD_WAXYSPLIT_DONGLE
    def_bool $(shields_list_contains,waxysplit_dongle)
```
